## CMakeLists.txt
```
cmake_minimum_required(VERSION 3.20.0)

find_package(Zephyr REQUIRED HINTS $ENV{ZEPHYR_BASE})
project(nrf_vwg_bridge_rx)

target_sources(app PRIVATE
    src/main.c
    src/bridge_proto.c
    src/radio_rx.c
)
```

## prj.conf
```kconfig
# Phase 1B receive-only nRF52840 bridge.
# This application listens to IEEE 802.15.4 and streams raw PSDUs over USB CDC.

CONFIG_MAIN_STACK_SIZE=4096
CONFIG_SYSTEM_WORKQUEUE_STACK_SIZE=2048

# USB CDC ACM serial transport.
CONFIG_USB_DEVICE_STACK=y
CONFIG_USB_CDC_ACM=y
CONFIG_SERIAL=y
CONFIG_UART_INTERRUPT_DRIVEN=n
CONFIG_UART_LINE_CTRL=y
CONFIG_CONSOLE=n
CONFIG_UART_CONSOLE=n

# Keep logging available for local debug, but do not route logs to the bridge
# CDC stream by default because host tools expect binary frames.
CONFIG_LOG=y
CONFIG_LOG_DEFAULT_LEVEL=3
CONFIG_LOG_BACKEND_UART=n

# Nordic IEEE 802.15.4 driver direct RX API.
CONFIG_NRF_802154_RADIO_DRIVER=y
CONFIG_NRF_802154_SOURCE_HAL_NORDIC=y

# No network stack, joining, association, shell, or operator command channel.
CONFIG_NETWORKING=n
CONFIG_NET_L2_IEEE802154=n
CONFIG_SHELL=n
```

## src/main.c
```c
#include <errno.h>
#include <stdint.h>

#include <zephyr/device.h>
#include <zephyr/drivers/uart.h>
#include <zephyr/kernel.h>
#include <zephyr/logging/log.h>
#include <zephyr/usb/usb_device.h>

#include "bridge_proto.h"
#include "radio_rx.h"

LOG_MODULE_REGISTER(nrf_vwg_bridge_rx, LOG_LEVEL_INF);

static uint8_t next_seq(void)
{
	static uint8_t seq;

	return seq++;
}

static int wait_for_cdc_acm(const struct device *uart)
{
	uint32_t dtr = 0U;

	if (!device_is_ready(uart)) {
		return -ENODEV;
	}

	if (usb_enable(NULL) != 0) {
		return -EIO;
	}

	while (dtr == 0U) {
		(void)uart_line_ctrl_get(uart, UART_LINE_CTRL_DTR, &dtr);
		k_sleep(K_MSEC(100));
	}

	return 0;
}

int main(void)
{
	const struct device *uart = DEVICE_DT_GET_ONE(zephyr_cdc_acm_uart);
	struct radio_rx_frame frame;
	int ret;

	ret = wait_for_cdc_acm(uart);
	if (ret != 0) {
		LOG_ERR("USB CDC ACM init failed: %d", ret);
		return ret;
	}

	(void)bridge_proto_send_hello_resp(uart, next_seq());

	ret = radio_rx_init(RADIO_RX_DEFAULT_CHANNEL);
	if (ret != 0) {
		static const uint8_t payload[] = "radio_rx_init_failed";

		(void)bridge_proto_send_frame(uart, BRIDGE_FRAME_ERROR, 0U, next_seq(),
					      payload, (uint16_t)(sizeof(payload) - 1U));
		return ret;
	}

	while (true) {
		ret = radio_rx_get(&frame);
		if (ret != 0) {
			radio_rx_count_output_error();
			continue;
		}

		const struct bridge_rx_payload rx = {
			.timestamp_us = frame.timestamp_us,
			.channel = frame.channel,
			.rssi_dbm = frame.rssi_dbm,
			.lqi = frame.lqi,
			.psdu = frame.psdu,
			.psdu_len = frame.psdu_len,
		};

		ret = bridge_proto_send_rx_frame(uart, next_seq(), &rx);
		if (ret != 0) {
			radio_rx_count_output_error();
		}
	}
}
```

## src/bridge_proto.c
```c
#include "bridge_proto.h"

#include <errno.h>
#include <string.h>

#include <zephyr/drivers/uart.h>
#include <zephyr/sys/byteorder.h>

#define BRIDGE_MAX_PAYLOAD_LEN (BRIDGE_RX_META_LEN + BRIDGE_MAX_PSDU_LEN)

static uint32_t crc32_ieee_update(uint32_t crc, const uint8_t *data, size_t len)
{
	crc = ~crc;
	for (size_t i = 0; i < len; i++) {
		crc ^= data[i];
		for (int bit = 0; bit < 8; bit++) {
			uint32_t mask = -(crc & 1U);

			crc = (crc >> 1) ^ (0xEDB88320U & mask);
		}
	}

	return ~crc;
}

static void uart_write_all(const struct device *uart, const uint8_t *data, size_t len)
{
	for (size_t i = 0; i < len; i++) {
		uart_poll_out(uart, data[i]);
	}
}

int bridge_proto_send_frame(const struct device *uart,
			    enum bridge_frame_type type,
			    uint8_t flags,
			    uint8_t seq,
			    const uint8_t *payload,
			    uint16_t payload_len)
{
	uint8_t header[BRIDGE_HEADER_LEN];
	uint8_t crc_buf[BRIDGE_CRC_LEN];
	uint32_t crc;

	if (uart == NULL) {
		return -EINVAL;
	}
	if (payload_len > 0U && payload == NULL) {
		return -EINVAL;
	}

	header[0] = BRIDGE_MAGIC_0;
	header[1] = BRIDGE_MAGIC_1;
	header[2] = BRIDGE_PROTO_VERSION;
	header[3] = (uint8_t)type;
	header[4] = flags;
	header[5] = seq;
	sys_put_le16(payload_len, &header[6]);

	crc = crc32_ieee_update(0U, header, sizeof(header));
	crc = crc32_ieee_update(crc, payload, payload_len);
	sys_put_le32(crc, crc_buf);

	uart_write_all(uart, header, sizeof(header));
	if (payload_len > 0U) {
		uart_write_all(uart, payload, payload_len);
	}
	uart_write_all(uart, crc_buf, sizeof(crc_buf));

	return 0;
}

int bridge_proto_send_hello_resp(const struct device *uart, uint8_t seq)
{
	static const uint8_t payload[] =
		"proto=1;name=nrf_vwg_bridge_rx;fw=0.1.0;cap=RX_ONLY";

	return bridge_proto_send_frame(uart, BRIDGE_FRAME_HELLO_RESP, 0U, seq,
				       payload, (uint16_t)(sizeof(payload) - 1U));
}

int bridge_proto_send_rx_frame(const struct device *uart,
			       uint8_t seq,
			       const struct bridge_rx_payload *rx)
{
	uint8_t payload[BRIDGE_MAX_PAYLOAD_LEN];

	if (rx == NULL || rx->psdu == NULL) {
		return -EINVAL;
	}
	if (rx->psdu_len > BRIDGE_MAX_PSDU_LEN) {
		return -EMSGSIZE;
	}

	sys_put_le64(rx->timestamp_us, &payload[0]);
	payload[8] = rx->channel;
	payload[9] = (uint8_t)rx->rssi_dbm;
	payload[10] = (uint8_t)rx->lqi;
	memcpy(&payload[BRIDGE_RX_META_LEN], rx->psdu, rx->psdu_len);

	return bridge_proto_send_frame(
		uart,
		BRIDGE_FRAME_RX_FRAME,
		0U,
		seq,
		payload,
		(uint16_t)(BRIDGE_RX_META_LEN + rx->psdu_len));
}
```

## src/bridge_proto.h
```c
#ifndef NRF_VWG_BRIDGE_RX_BRIDGE_PROTO_H_
#define NRF_VWG_BRIDGE_RX_BRIDGE_PROTO_H_

#include <stdint.h>
#include <stddef.h>

#include <zephyr/device.h>

#define BRIDGE_MAGIC_0 'V'
#define BRIDGE_MAGIC_1 'W'
#define BRIDGE_PROTO_VERSION 1
#define BRIDGE_HEADER_LEN 8
#define BRIDGE_CRC_LEN 4
#define BRIDGE_RX_META_LEN 11
#define BRIDGE_MAX_PSDU_LEN 127

enum bridge_frame_type {
	BRIDGE_FRAME_HELLO = 0x01,
	BRIDGE_FRAME_HELLO_RESP = 0x02,
	BRIDGE_FRAME_RX_FRAME = 0x03,
	BRIDGE_FRAME_TX_RAW_RESERVED = 0x04,
	BRIDGE_FRAME_STATE = 0x05,
	BRIDGE_FRAME_ERROR = 0x06,
	BRIDGE_FRAME_GET_STATS = 0x07,
	BRIDGE_FRAME_GET_STATS_RESP = 0x08,
};

struct bridge_rx_payload {
	uint64_t timestamp_us;
	uint8_t channel;
	int8_t rssi_dbm;
	int8_t lqi;
	const uint8_t *psdu;
	uint8_t psdu_len;
};

int bridge_proto_send_frame(const struct device *uart,
			    enum bridge_frame_type type,
			    uint8_t flags,
			    uint8_t seq,
			    const uint8_t *payload,
			    uint16_t payload_len);

int bridge_proto_send_hello_resp(const struct device *uart, uint8_t seq);

int bridge_proto_send_rx_frame(const struct device *uart,
			       uint8_t seq,
			       const struct bridge_rx_payload *rx);

#endif
```

## src/radio_rx.c
```c
#include "radio_rx.h"

#include <errno.h>
#include <string.h>

#include <nrf_802154.h>
#include <zephyr/kernel.h>
#include <zephyr/logging/log.h>

LOG_MODULE_REGISTER(radio_rx, LOG_LEVEL_INF);

K_MSGQ_DEFINE(rx_msgq, sizeof(struct radio_rx_frame), RADIO_RX_QUEUE_DEPTH, 4);

static uint8_t current_channel = RADIO_RX_DEFAULT_CHANNEL;
static struct radio_rx_stats stats;

int radio_rx_init(uint8_t channel)
{
	if (channel < 11U || channel > 26U) {
		return -EINVAL;
	}

	current_channel = channel;

	nrf_802154_init();
	nrf_802154_channel_set(channel);
	nrf_802154_promiscuous_set(true);

	if (!nrf_802154_receive()) {
		return -EIO;
	}

	LOG_INF("802.15.4 RX-only sniffer started on channel %u", channel);
	return 0;
}

int radio_rx_get(struct radio_rx_frame *frame)
{
	if (frame == NULL) {
		return -EINVAL;
	}

	return k_msgq_get(&rx_msgq, frame, K_FOREVER);
}

void radio_rx_count_output_error(void)
{
	stats.output_errors++;
}

struct radio_rx_stats radio_rx_get_stats(void)
{
	return stats;
}

void nrf_802154_received_raw(uint8_t *data, int8_t power, uint8_t lqi)
{
	struct radio_rx_frame frame;
	uint8_t psdu_len;

	if (data == NULL) {
		stats.rx_dropped++;
		return;
	}

	/*
	 * Nordic raw RX buffers are length-prefixed: data[0] is the PSDU length,
	 * followed by the raw 802.15.4 PSDU bytes expected by the Python decoder.
	 */
	psdu_len = data[0];
	if (psdu_len > RADIO_RX_MAX_PSDU_LEN) {
		stats.rx_dropped++;
		nrf_802154_buffer_free_raw(data);
		return;
	}

	memset(&frame, 0, sizeof(frame));
	frame.timestamp_us = (uint64_t)k_ticks_to_us_floor64(k_uptime_ticks());
	frame.channel = current_channel;
	frame.rssi_dbm = power;
	frame.lqi = (int8_t)lqi;
	frame.psdu_len = psdu_len;
	memcpy(frame.psdu, &data[1], psdu_len);

	if (k_msgq_put(&rx_msgq, &frame, K_NO_WAIT) != 0) {
		stats.rx_dropped++;
	} else {
		stats.rx_frames++;
	}

	nrf_802154_buffer_free_raw(data);
}

void nrf_802154_receive_failed(nrf_802154_rx_error_t error, uint32_t id)
{
	ARG_UNUSED(error);
	ARG_UNUSED(id);

	stats.rx_dropped++;
	(void)nrf_802154_receive();
}
```

## src/radio_rx.h
```c
#ifndef NRF_VWG_BRIDGE_RX_RADIO_RX_H_
#define NRF_VWG_BRIDGE_RX_RADIO_RX_H_

#include <stdint.h>

#define RADIO_RX_DEFAULT_CHANNEL 15
#define RADIO_RX_QUEUE_DEPTH 16
#define RADIO_RX_MAX_PSDU_LEN 127

struct radio_rx_frame {
	uint64_t timestamp_us;
	uint8_t channel;
	int8_t rssi_dbm;
	int8_t lqi;
	uint8_t psdu_len;
	uint8_t psdu[RADIO_RX_MAX_PSDU_LEN];
};

struct radio_rx_stats {
	uint32_t rx_frames;
	uint32_t rx_dropped;
	uint32_t output_errors;
};

int radio_rx_init(uint8_t channel);
int radio_rx_get(struct radio_rx_frame *frame);
void radio_rx_count_output_error(void);
struct radio_rx_stats radio_rx_get_stats(void);

#endif
```
